// SPDX-License-Identifier: GPL-2.0-or-later OR BSD-3-Clause
/*
 * Copyright (C) STMicroelectronics 2022 - All Rights Reserved
 */

#include "stm32mp25-u-boot.dtsi"

/ {
	config {
		u-boot,mmc-env-partition = "u-boot-env";
	};
};

&dwc3 {
	dr_mode = "peripheral";
};
