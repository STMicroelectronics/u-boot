// SPDX-License-Identifier: (GPL-2.0-only OR BSD-3-Clause)
/*
 * Copyright (C) STMicroelectronics 2023 - All Rights Reserved
 * Author: Alexandre Torgue <alexandre.torgue@foss.st.com> for STMicroelectronics.
 */

/dts-v1/;

#include "stm32mp157.dtsi"
#include "stm32mp15xd.dtsi"
#include "stm32mp15-pinctrl.dtsi"
#include "stm32mp15xxac-pinctrl.dtsi"
#include "stm32mp15xx-dkx.dtsi"
#include "stm32mp157a-dk1-scmi.dtsi"

/ {
	model = "STMicroelectronics STM32MP157D-DK1 Discovery Board";
	compatible = "st,stm32mp157d-dk1", "st,stm32mp157";

	aliases {
		ethernet0 = &ethernet0;
	};

	chosen {
		stdout-path = "serial0:115200n8";
	};
};
